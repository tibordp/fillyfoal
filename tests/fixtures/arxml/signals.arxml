AUTOSAR XML (schema 4.0)
package /Signals
  i signal EngineSpeed: length=16
